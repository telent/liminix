## pkgs/kernel/kernel_fdt.its
```
/dts-v1/;

//  used on arm/aarch64 to provide a U-bootable image that combines
//  kernel and fdt

/ {
    description = "Simple image with single Linux kernel and FDT blob";
    #address-cells = <1>;

    images {
        kernel {
            description = "Vanilla Linux kernel";
            // data = /incbin/("./vmlinux.bin.gz");
            type = "kernel";
            // arch = "arm64";
            os = "linux";
            // compression = "gzip";
            // load = <00000000>;
            // entry = <00000000>;
            hash-1 {
                    algo = "crc32";
            };
            hash-2 {
                    algo = "sha1";
            };
        };
        fdt-1 {
            description = "Flattened Device Tree blob";
            // data = /incbin/("./target.dtb");
            type = "flat_dt";
            // arch = "arm64";
            compression = "none";
            hash-1 {
                    algo = "crc32";
            };
            hash-2 {
                    algo = "sha1";
            };
        };
    };

    configurations {
        // The OpenWRT One wants this to be 'config-1' specifically. For now it's
        // easy to just choose that, if there's another device that has a
        // different restriction then we should probably add 'if not found
        // select default' logic and/or make this configurable.
        default = "config-1";
        config-1 {
            description = "Boot Linux kernel with FDT blob";
            kernel = "kernel";
            fdt = "fdt-1";
        };
    };
};
```
